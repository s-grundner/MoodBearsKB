## config/boards/shields/mbkb/Kconfig.defconfig
```kconfig
if SHIELD_MBKB_DONGLE

config ZMK_KEYBOARD_NAME
    default "MBKB"
    
config ZMK_SPLIT_ROLE_CENTRAL
    default y

config ZMK_SPLIT_BLE_CENTRAL_BATTERY_LEVEL_FETCHING
    default y

config ZMK_SPLIT_BLE_CENTRAL_BATTERY_LEVEL_PROXY
    default y

config BT_MAX_CONN
    default 6

config BT_MAX_PAIRED
    default 6

config BT_GATT_ENFORCE_SUBSCRIPTION
    default n

config ZMK_USB
    default y

endif

if SHIELD_MBKB_LEFT || SHIELD_MBKB_RIGHT || SHIELD_MBKB_DONGLE

config ZMK_SPLIT
    default y

config ZMK_BLE
    default y

endif
```

## firmware/zmk-config/config/boards/shields/mbkb/Kconfig.shield
```kconfig
config SHIELD_MBKB_LEFT
    def_bool $(shields_list_contains, mbkb_left)

config SHIELD_MBKB_RIGHT
    def_bool $(shields_list_contains, mbkb_right)
```
